## main/Kconfig.projbuild
```kconfig
menu "Example Audio Configuration"

#
# Select how the audio conversation is triggered
#
choice
    prompt "Audio Conversation Trigger Mode"
    default VOICE_WAKEUP_MODE if IDF_TARGET_ESP32S3
    default VOICE_WAKEUP_MODE if IDF_TARGET_ESP32C3
    default CONTINUOUS_CONVERSATION_MODE

config VOICE_WAKEUP_MODE
    bool "Wake Word Mode"
    select SR_WN_WN9_HILEXIN if IDF_TARGET_ESP32S3
    select SR_WN_WN9S_HILEXIN if IDF_TARGET_ESP32C3
    help
      System is activated by a predefined wake word (e.g. 'Hi Lexin').

config CONTINUOUS_CONVERSATION_MODE
    bool "Continuous Mode"
    help
      Keeps the system active after the initial trigger for ongoing conversation.

config KEY_PRESS_DIALOG_MODE
    bool "Key Press Mode"
    help
      System is triggered by a physical key press.

endchoice

#
# Select audio upload encoding format
#
choice
    prompt "Audio Upload Encoding Format"
    default UPLOAD_FORMAT_OPUS
    help
      Select the audio format for uploading voice data to COZE service.

config UPLOAD_FORMAT_OPUS
    bool "OPUS"
    help
      Use OPUS encoding for uploading audio data.

config UPLOAD_FORMAT_PCM
    bool "PCM"
    help
      Use PCM encoding for uploading audio data.
      Note: Not recommended for production use due to large data size.

config UPLOAD_FORMAT_G711A
    bool "G711A (A-law)"
    help
      Use G711A (A-law) encoding for uploading audio data.

config UPLOAD_FORMAT_G711U
    bool "G711U (μ-law)"
    help
      Use G711U (μ-law) encoding for uploading audio data.

endchoice

#
# Select audio download decoding format
#
choice
    prompt "Audio Download Decoding Format"
    default DOWNLOAD_FORMAT_OPUS
    help
      Select the audio format for downloading voice data from COZE service.

config DOWNLOAD_FORMAT_OPUS
    bool "OPUS"
    help
      Use OPUS decoding for downloading audio data.

config DOWNLOAD_FORMAT_PCM
    bool "PCM"
    help
      Use PCM decoding for downloading audio data.
      Note: Not recommended for production use due to large data size.

config DOWNLOAD_FORMAT_G711A
    bool "G711A (A-law)"
    help
      Use G711A (A-law) decoding for downloading audio data.

config DOWNLOAD_FORMAT_G711U
    bool "G711U (μ-law)"
    help
      Use G711U (μ-law) decoding for downloading audio data.

endchoice

config ENABLE_RECORDER_DEBUG
    bool "Enable AEC Debug"
    default n
    help
      Enable AEC (Acoustic Echo Cancellation) debug functionality.
      When enabled, AEC debug data will be written for debugging purposes.

config COZE_BOT_ID
    string "COZE_BOT_ID"
    default "7544002988382257191"

config COZE_ACCESS_TOKEN
    string "COZE_ACCESS_TOKEN"
    default "pat_<rm>"

endmenu

menu "SensorLib Example Configuration"

    choice SensorLib_ESP_IDF_API
        prompt "SensorLib library esp-idf api version"
        default SENSORLIB_ESP_IDF_NEW_API if IDF_TARGET_ESP32S3
        default SENSORLIB_ESP_IDF_OLD_API if IDF_TARGET_ESP32C6
        default SENSORLIB_ESP_IDF_NEW_API
        help
            Define API version

        config SENSORLIB_ESP_IDF_NEW_API
            bool "Use esp-idf higher version (>= 5.0) API"
        config SENSORLIB_ESP_IDF_OLD_API
            bool "Use esp-idf lower version (< 5.0) API, Compatible with lower versions of esp-idf"
    endchoice

    choice SENSOR_TYPE
        prompt "Select Sensor Type"
        default PCF8563
        help
            Choose the type of sensor you are using.

        config PCF8563
            bool "PCF8563 Sensor"
        config BMA423
            bool "BMA423 Sensor"
        config BHI260
            bool "BHI260 Sensor"
        config FT636X
            bool "FT636X Capacitive touch"
        config XL9555
            bool "XL9555 GPIO expansion"
    endchoice

    choice BHI260_COMMUNICATION_TYPE
        prompt "Select BHI260 Communication Type"
        default USE_I2C_INTERFACE
        depends on BHI260
        help
            Choose the communication type for BHI260 sensor.

        config USE_I2C_INTERFACE
            bool "I2C Communication"
        config USE_SPI_INTERFACE
            bool "SPI Communication"
    endchoice

    choice I2C_COMMUNICATION_METHOD
        prompt "SensorLib read and write methods"
        default I2C_COMMUNICATION_METHOD_BUILTIN_RW
        depends on (PCF8563 || BMA423 || FT636X || XL9555 || (BHI260 && USE_I2C_INTERFACE))
        help
            Define SensorLib read and write methods

        config I2C_COMMUNICATION_METHOD_BUILTIN_RW
            bool "Implemented using built-in read and write methods"
        config I2C_COMMUNICATION_METHOD_CALLBACK_RW
            bool "Implemented using read and write callback methods"
    endchoice

    config I2C_MASTER_PORT_NUM
        int "Sensor I2C Port Number"
        default 0 if IDF_TARGET_ESP32S3
        default 0 if IDF_TARGET_ESP32C6
        default 1
        depends on (PCF8563 || BMA423 || FT636X || XL9555 ||  (BHI260 && USE_I2C_INTERFACE))
        help
            Port number for I2C Master device.

    config I2C_MASTER_FREQUENCY
        int "Master Frequency"
        default 400000 if IDF_TARGET_ESP32S3
        default 400000 if IDF_TARGET_ESP32C6
        default 100000
        depends on (PCF8563 || BMA423 || FT636X || XL9555 ||  (BHI260 && USE_I2C_INTERFACE))
        help
            I2C Speed of Master device.

    config SENSOR_SCL
        int "Sensor SCL GPIO Num"
        default 5 if IDF_TARGET_ESP32S3
        default 10 if IDF_TARGET_ESP32C6
        default -1
        depends on (PCF8563 || BMA423 || FT636X || XL9555 ||  (BHI260 && USE_I2C_INTERFACE))
        help
            GPIO number for I2C clock line.

    config SENSOR_SDA
        int "Sensor SDA GPIO Num"
        default 0 if IDF_TARGET_ESP32S3
        default 11 if IDF_TARGET_ESP32C6
        default -1
        depends on (PCF8563 || BMA423 || FT636X || XL9555 ||   (BHI260 && USE_I2C_INTERFACE))
        help
            GPIO number for I2C data line.

    config SPI_MISO
        int "SPI MISO GPIO Num"
        default -1
        depends on (BHI260 && USE_SPI_INTERFACE)
        help
            GPIO number for Sensor SPI MISO line.

    config SPI_MOSI
        int "SPI MOSI GPIO Num"
        default -1
        depends on (BHI260 && USE_SPI_INTERFACE)
        help
            GPIO number for Sensor SPI MOSI line.

    config SPI_SCK
        int "SPI SCK GPIO Num"
        default -1
        depends on (BHI260 && USE_SPI_INTERFACE)
        help
            GPIO number for Sensor SPI SCK line.

    config SPI_CS
        int "SPI CS GPIO Num"
        default -1
        depends on (BHI260 && USE_SPI_INTERFACE)
        help
            GPIO number for Sensor SPI CS line.

    config SENSOR_IRQ
        int "Sensor Interrupt Pin"        
        default -1
        help
            GPIO number for Sensor Interrupt line.

    config SENSOR_RST
        int "Sensor reset Pin"
        default -1
        help
            GPIO number for Sensor Reset line.

endmenu
```
